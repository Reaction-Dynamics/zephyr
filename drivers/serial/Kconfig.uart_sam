## drivers/serial/Kconfig.uart_sam
```kconfig
# Atmel SAM UART configuration options

# Copyright (c) 2017 Piotr Mienkowski
# Copyright (c) 2018 Justin Watson
# SPDX-License-Identifier: Apache-2.0

config UART_SAM
	bool "Atmel SAM MCU family UART driver"
	default y
	depends on DT_HAS_ATMEL_SAM_UART_ENABLED
	select PINCTRL
	select SERIAL_HAS_DRIVER
	select SERIAL_SUPPORT_INTERRUPT
	select SERIAL_SUPPORT_ASYNC if DT_HAS_ATMEL_SAM_XDMAC_ENABLED
	help
	  This option enables the UARTx driver for Atmel SAM MCUs.

config UART_SAM_ASYNC
	bool "Async UART support for Atmel SAM0 series."
	depends on DMA_SAM_XDMAC
	depends on UART_SAM
	depends on UART_ASYNC_API
```

## dts/bindings/serial/atmel,sam-uart.yaml
```yaml
description: SAM family UART

compatible: "atmel,sam-uart"

include:
  - name: uart-controller.yaml
  - name: pinctrl-device.yaml
  - name: atmel,assigned-clocks.yaml

properties:
  reg:
    required: true

  interrupts:
    required: true

  clocks:
    required: true

  dmas:
    description: |
      Optional TX & RX dma specifiers.  Each specifier will have a phandle
      reference to the dmac controller, the channel number, and peripheral
      trigger source.

      For example dmas for TX, RX on SERCOM3
         dmas = <&dmac 0 0xb>, <&dmac 0 0xa>;

  dma-names:
    description: |
      Required if the dmas property exists.  This should be "tx" and "rx"
      to match the dmas property.

      For example
         dma-names = "tx", "rx";
```
